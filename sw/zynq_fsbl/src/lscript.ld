/**************************************************************************/
/*                                                                        */
/* This file should be automatically generated by linker script generator.*/
/*                                                                        */
/* Version: Xilinx                                                        */
/*                                                                        */
/* Copyright (c) 2010 Xilinx, Inc.  All rights reserved.                  */
/*                                                                        */
/* Description : FSBL Linker Script                                       */
/*                                                                        */
/**************************************************************************/

_STACK_SIZE = DEFINED(_STACK_SIZE) ? _STACK_SIZE : 0x6000;
_HEAP_SIZE = DEFINED(_HEAP_SIZE) ? _HEAP_SIZE : 0x1000;

/* Define Memory segments in the system
 * SEGMENT_ONE holds text and data sections
 * SEGMENT_TWO holds bss, heap and stack
 *
 * FSBL has 0x40000 bytes, split as 0x10000 - 0x2FFFF, and 
 * 0xFFFF0000 - 0xFFFFFFFF
 */
MEMORY
{
   SEGMENT_ONE : ORIGIN = 0x00000000, LENGTH = 0x00030000
 /*  SEGMENT_TWO : ORIGIN = 0x00020000, LENGTH = 0x00010000 */
   SEGMENT_TWO : ORIGIN = 0xFFFF0000, LENGTH = 0x000FE00
}

/* Specify the default entry point to the program */

ENTRY(_vector_table)

/* Define the sections, and where they are mapped in memory */

SECTIONS
{
.boot 0x00000000: {
   *(.vectors)
   *(.boot)
} > SEGMENT_ONE

.text : {
   *(.text)
   *(.gnu.linkonce.t.*)
} > SEGMENT_ONE

.jtag 0x00007E40 : {
        *(.jtag)
} > SEGMENT_ONE

.handoff 0x0000FF40 : {
        *(.handoff)
} > SEGMENT_ONE


.mmu_tbl 0x0010000: {
        *(.mmu_tbl)
}> SEGMENT_ONE

.init : {
   KEEP (*(.init))
} > SEGMENT_ONE

.fini : {
   KEEP (*(.fini))
} > SEGMENT_ONE

.glue_7 : {
   KEEP (*(.glue_7))
} > SEGMENT_ONE

.glue_7t : {
   KEEP (*(.glue_7t))
} > SEGMENT_ONE

.rodata : {
   __rodata_start = .;
   *(.rodata)
   *(.rodata.*)
   *(.gnu.linkonce.r.*)
   __rodata_end = .;
} > SEGMENT_ONE

.rodata1 : {
   __rodata1_start = .;
   *(.rodata1)
   *(.rodata1.*)
   __rodata1_end = .;
} > SEGMENT_ONE

.eh_frame : {
   *(.eh_frame)
} > SEGMENT_ONE

.ARM.extab : {
   KEEP (*(.ARM.extab))
} > SEGMENT_ONE

.ARM.exidx : {
   __exidx_start = .;
   *(.ARM.exidx* .gnu.linkonce.armexidx.*)
   __exidx_end = .;
} > SEGMENT_ONE

.got : {
   *(.got)
} > SEGMENT_ONE

.got1 : {
   *(.got1)
} > SEGMENT_ONE

.got2 : {
   *(.got2)
} > SEGMENT_ONE

.ctors : {
   __CTOR_LIST__ = .;
   ___CTORS_LIST___ = .;
   KEEP (*crtbegin.o(.ctors))
   KEEP (*(EXCLUDE_FILE(*crtend.o) .ctors))
   KEEP (*(SORT(.ctors.*)))
   KEEP (*(.ctors))
   __CTOR_END__ = .;
   ___CTORS_END___ = .;
} > SEGMENT_ONE


.dtors : {
   __DTOR_LIST__ = .;
   ___DTORS_LIST___ = .;
   KEEP (*crtbegin.o(.dtors))
   KEEP (*(EXCLUDE_FILE(*crtend.o) .dtors))
   KEEP (*(SORT(.dtors.*)))
   KEEP (*(.dtors))
   __DTOR_END__ = .;
   ___DTORS_END___ = .;
} > SEGMENT_ONE

.fixup : {
   __fixup_start = .;
   *(.fixup)
   __fixup_end = .;
} > SEGMENT_ONE

.jcr : {
   *(.jcr)
} > SEGMENT_ONE

.gcc_except_table : {
   *(.gcc_except_table)
} > SEGMENT_ONE


.init_array : {
__init_array_start = . ;
   KEEP (*(.init_array))
__init_array_end = . ;
} > SEGMENT_ONE

.comment : {
   KEEP (*(.comment))
} > SEGMENT_ONE

.plt : {
   KEEP (*(.plt))
} > SEGMENT_ONE

.interp : {
   KEEP (*(.interp))
} > SEGMENT_ONE

.note.ABI-tag : {
   KEEP (*(.note.ABI-tag))
} > SEGMENT_ONE

.interp : {
   KEEP (*(.interp))
} > SEGMENT_ONE

.note.ABI-tag : {
   KEEP (*(.note.ABI-tag))
} > SEGMENT_ONE

.hash : {
   KEEP (*(.hash))
} > SEGMENT_ONE

.dynsym : {
   KEEP (*(.dynsym))
} > SEGMENT_ONE

.dynstr : {
   KEEP (*(.dynstr))
} > SEGMENT_ONE

.gnu.version : {
   KEEP (*(.version))
} > SEGMENT_ONE

.gnu.version_r : {
   KEEP (*(.gnu.version_r))
} > SEGMENT_ONE

.gnu.version_d : {
   KEEP (*(.gnu.version_d))
} > SEGMENT_ONE

.rel.dyn : {
   KEEP (*(.rel.dyn))
} > SEGMENT_ONE

.rel.plt : {
   KEEP (*(.rel.plt))
} > SEGMENT_ONE

.got.plt : {
   KEEP (*(.got.plt))
} > SEGMENT_ONE

.init : {
   KEEP (*(.note.ABI-tag))
} > SEGMENT_ONE

.fini_array : {
   KEEP (*(.fini_array))
} > SEGMENT_ONE

.ARM.attributes :{
   KEEP (*(.ARM.attributes))
} > SEGMENT_ONE

.dynbss : {
   KEEP (*(.dynbss))
} > SEGMENT_ONE

.dynamic : {
   KEEP (*(.dynamic))
} > SEGMENT_ONE

.sdata2 : {
   __sdata2_start = .;
   *(.sdata2)
   *(.sdata2.*)
   *(.gnu.linkonce.s2.*)
   __sdata2_end = .;
} > SEGMENT_ONE

.data : {
   __data_start = .;
   *(.data)
   *(.data.*)
   *(.gnu.linkonce.d.*)
   __data_end = .;
} > SEGMENT_ONE

.data1 : {
   __data1_start = .;
   *(.data1)
   *(.data1.*)
   __data1_end = .;
} > SEGMENT_ONE


.sdata : {
   __sdata_start = .;
   *(.sdata)
   *(.sdata.*)
   *(.gnu.linkonce.s.*)
   __sdata_end = .;
} > SEGMENT_ONE

.tdata : {
   __tdata_start = .;
   *(.tdata)
   *(.tdata.*)
   *(.gnu.linkonce.td.*)
   __tdata_end = .;
} > SEGMENT_ONE


.sbss2 : {
   __sbss2_start = .;
   *(.sbss2)
   *(.sbss2.*)
   *(.gnu.linkonce.sb2.*)
   __sbss2_end = .;
} > SEGMENT_ONE

.sbss : {
   __sbss_start = .;
   *(.sbss)
   *(.sbss.*)
   *(.gnu.linkonce.sb.*)
   *(.scommon)
   __sbss_end = .;
} > SEGMENT_ONE

.tbss : {
   __tbss_start = .;
   *(.tbss)
   *(.tbss.*)
   *(.gnu.linkonce.tb.*)
   __tbss_end = .;
} > SEGMENT_ONE

.bss : {
__bss_start__ = .;
__bss_start = .;
   *(.bss)
   *(.bss.*)
   *(.gnu.linkonce.b.*)
   *(COMMON)
   . = ALIGN(4);
__bss_end = .;
__bss_end__ = .;
} > SEGMENT_ONE

/* Generate Stack and Heap Sections */
.heap : {
   . = ALIGN(16);
   _heap_start = .;
  HeapBase = .;
   . += _HEAP_SIZE;
   . = ALIGN(16);
  HeapLimit = .;
   _heap_end = .;
   _end = .;
   _end = .;
 __end__ = . ;
 _end = .;
 PROVIDE (end = .);
} > SEGMENT_ONE


.stack : {
   _stack_end = .;
   . += _STACK_SIZE;
   . = ALIGN(16);
   __stack = .;
} > SEGMENT_TWO

}

